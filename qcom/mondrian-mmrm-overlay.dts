// SPDX-License-Identifier: GPL-2.0-only
/*
 * PE-Reborn mondrian (SM8475 / CAPE): multimedia resource manager (MMRM).
 *
 * Values from the stock OS3.0.8.0.VMNCNXM firmware (CAPE DTB + mondrian
 * DTBO): five CAPE voltage corners with their voltage, dynamic and leakage
 * scaling factors and the 28 nominal clock-source entries. Their format is
 * exactly what mmrm-driver 69e304b parses (corners: mm-rail-*,
 * scaling-fact-*; entries: domain, clk_src_id, nom_dyn_pwr, nom_leak_pwr,
 * num_hw_block), and every clock id resolves to a *_CLK_SRC of our kernel
 * headers. Without this node msm-mmrm.ko does not probe.
 */
/dts-v1/;
/plugin/;

#include <dt-bindings/clock/qcom,camcc-waipio.h>
#include <dt-bindings/clock/qcom,dispcc-waipio.h>
#include <dt-bindings/clock/qcom,videocc-waipio.h>

/* enum mmrm_client_domain, include/linux/soc/qcom/msm_mmrm.h */
#define MMRM_DOMAIN_CAMERA	1
#define MMRM_DOMAIN_CVP		2
#define MMRM_DOMAIN_DISPLAY	3
#define MMRM_DOMAIN_VIDEO	4

&soc {
	qcom,mmrm {
		compatible = "qcom,msm-mmrm", "qcom,waipio-mmrm";
		status = "okay";

		mm-rail-corners = "lowsvs", "svs", "svsl1", "nom", "turbo";
		mm-rail-fact-volt = <0x926f 0xa0c5 0xaf1b 0xba5f 0xcccd>;
		scaling-fact-dyn = <0x9c0f 0xbe0e 0xe3eb 0x10475 0x13f5d>;
		scaling-fact-leak = <0x9c0f 0xa4035 0xbf72c 0xd7ef4 0x108639>;

		/* domain, clock source, nominal dynamic power, nominal leakage power, HW blocks */
		mmrm-client-info =
			<MMRM_DOMAIN_CAMERA CAM_CC_IFE_0_CLK_SRC 0x1b8dd6a 0x33334 1>,
			<MMRM_DOMAIN_CAMERA CAM_CC_IFE_1_CLK_SRC 0x1b8dd6a 0x33334 1>,
			<MMRM_DOMAIN_CAMERA CAM_CC_IFE_2_CLK_SRC 0x1b8dd6a 0x33334 1>,
			<MMRM_DOMAIN_CAMERA CAM_CC_CSID_CLK_SRC 0x1c5aad 0x0 3>,
			<MMRM_DOMAIN_CAMERA CAM_CC_SFE_0_CLK_SRC 0xfd29b1 0x1c667 1>,
			<MMRM_DOMAIN_CAMERA CAM_CC_SFE_1_CLK_SRC 0xfd29b1 0x1c667 1>,
			<MMRM_DOMAIN_CAMERA CAM_CC_IPE_NPS_CLK_SRC 0x374c49c 0x7574c 1>,
			<MMRM_DOMAIN_CAMERA CAM_CC_BPS_CLK_SRC 0x1044539 0x20625 1>,
			<MMRM_DOMAIN_CAMERA CAM_CC_IFE_LITE_CLK_SRC 0x164a3e 0x4a3e 5>,
			<MMRM_DOMAIN_CAMERA CAM_CC_JPEG_CLK_SRC 0xd4746 0x0 2>,
			<MMRM_DOMAIN_CAMERA CAM_CC_CAMNOC_AXI_CLK_SRC 0x2cb852 0x6ee15 1>,
			<MMRM_DOMAIN_CAMERA CAM_CC_IFE_LITE_CSID_CLK_SRC 0x370a4 0x0 5>,
			<MMRM_DOMAIN_CAMERA CAM_CC_ICP_CLK_SRC 0x420c5 0x0 1>,
			<MMRM_DOMAIN_CAMERA CAM_CC_CPHY_RX_CLK_SRC 0x2ec8c 0x0 9>,
			<MMRM_DOMAIN_CAMERA CAM_CC_CSI0PHYTIMER_CLK_SRC 0x1605 0x0 1>,
			<MMRM_DOMAIN_CAMERA CAM_CC_CSI1PHYTIMER_CLK_SRC 0x1605 0x0 1>,
			<MMRM_DOMAIN_CAMERA CAM_CC_CSI2PHYTIMER_CLK_SRC 0x1605 0x0 1>,
			<MMRM_DOMAIN_CAMERA CAM_CC_CSI3PHYTIMER_CLK_SRC 0x1605 0x0 1>,
			<MMRM_DOMAIN_CAMERA CAM_CC_CSI4PHYTIMER_CLK_SRC 0x1605 0x0 1>,
			<MMRM_DOMAIN_CAMERA CAM_CC_CSI5PHYTIMER_CLK_SRC 0x1605 0x0 1>,
			<MMRM_DOMAIN_CAMERA CAM_CC_CCI_0_CLK_SRC 0x234 0x0 1>,
			<MMRM_DOMAIN_CAMERA CAM_CC_CCI_1_CLK_SRC 0x234 0x0 1>,
			<MMRM_DOMAIN_CAMERA CAM_CC_SLOW_AHB_CLK_SRC 0xeb93 0x0 1>,
			<MMRM_DOMAIN_CAMERA CAM_CC_FAST_AHB_CLK_SRC 0x76e3 0x0 1>,
			<MMRM_DOMAIN_CVP VIDEO_CC_MVS1_CLK_SRC 0x3c10000 0x53d71 1>,
			<MMRM_DOMAIN_DISPLAY DISP_CC_MDSS_MDP_CLK_SRC 0x117ee15 0x3d70b 1>,
			<MMRM_DOMAIN_DISPLAY DISP_CC_MDSS_DPTX0_LINK_CLK_SRC 0xdee15 0x147b 1>,
			<MMRM_DOMAIN_VIDEO VIDEO_CC_MVS0_CLK_SRC 0x229851f 0x74290 1>;
	};
};
